#include <Arduino.h>
#include <math.h>
#include <WiFi.h>
#include <esp_now.h>

// Substitua pelo endereço MAC da sua segunda ESP32 (A que tem o Servo/LED)
uint8_t macESP2[] = {0xFF, 0xFF, 0xFF, 0xFF, 0xFF, 0xFF}; 

#define WIDTH 64
#define HEIGHT 64
#define FRAME_SIZE (WIDTH * HEIGHT)

uint8_t inputImage[HEIGHT][WIDTH];
uint8_t outputImage[HEIGHT][WIDTH];

// O "Banco de Dados" (O rosto ideal)
// TODO: Mais tarde precisaremos capturar seu rosto real e colar os valores aqui
uint8_t rostoIdeal[HEIGHT][WIDTH] = {
    {0, 0, 0, 0, 0, 0, 0, 0, 0, 0, 0, 0, 0,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 0, 0},
    {0, 8, 6, 8, 12, 10, 10, 8, 11, 14, 13, 13, 13,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 255, 0},
    {0, 7, 7, 8, 12, 11, 10, 12, 11, 13, 14, 14, 10,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 255, 0},
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    {0, 0, 0, 0, 0, 0, 0, 0, 0, 0, 0, 0, 0,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 0, 0}
};


// Estrutura do pacote de dados que será enviado via ESP-NOW
typedef struct struct_mensagem {
    bool reconhecido;
} struct_mensagem;

struct_mensagem dadosEnvio;
esp_now_peer_info_t peerInfo;

const int Gx[3][3] = {{-1, 0, 1}, {-2, 0, 2}, {-1, 0, 1}};
const int Gy[3][3] = {{ 1, 2, 1}, { 0, 0, 0}, {-1,-2,-1}};

TaskHandle_t TaskProcess_Handle;

// =========================================================================
void aplicarSobel() {
    for (int y = 1; y < HEIGHT - 1; y++) {
        for (int x = 1; x < WIDTH - 1; x++) {
            int somaX = 0, somaY = 0;
            for (int i = -1; i <= 1; i++) {
                for (int j = -1; j <= 1; j++) {
                    int pixel = inputImage[y + i][x + j];
                    somaX += pixel * Gx[i + 1][j + 1];
                    somaY += pixel * Gy[i + 1][j + 1];
                }
            }
            int magnitude = sqrt((somaX * somaX) + (somaY * somaY));
            if (magnitude > 255) magnitude = 255;
            outputImage[y][x] = (uint8_t)magnitude;
        }
    }
}

// =========================================================================
// ALGORITMO DE CLASSIFICAÇÃO (SAD)
// =========================================================================
long calcularSAD() {
    long diferencaTotal = 0;
    for (int y = 1; y < HEIGHT - 1; y++) {
        for (int x = 1; x < WIDTH - 1; x++) {
            diferencaTotal += abs(outputImage[y][x] - rostoIdeal[y][x]);
        }
    }
    return diferencaTotal;
}

// =========================================================================
void receiveSerialTask(void *pvParameters) {
    for (;;) {
        if (Serial.available() > 0) {
            if (Serial.read() == 'S') {
                size_t lidos = Serial.readBytes((uint8_t*)inputImage, FRAME_SIZE);
                if (lidos == FRAME_SIZE) {
                    xTaskNotifyGive(TaskProcess_Handle);
                }
            }
        }
        vTaskDelay(pdMS_TO_TICKS(5)); 
    }
}

// =========================================================================
void processImageTask(void *pvParameters) {
    for (;;) {
        ulTaskNotifyTake(pdTRUE, portMAX_DELAY);

        // 1. Extração de Características (Sobel)
        aplicarSobel();

        // 2. Classificação
        long diferenca = calcularSAD();
        
        // Calibre este valor olhando o terminal do Python!
        long threshold = 150000; 
        bool ehOAluno = (diferenca < threshold);

        // 3. Comunicação ESP-NOW (Deixamos pronto para quando a placa chegar)
        dadosEnvio.reconhecido = ehOAluno;
        esp_now_send(macESP2, (uint8_t *) &dadosEnvio, sizeof(dadosEnvio));

        // 4. Feedback via Serial para o script Python
        // O Python vai receber isso e imprimir no terminal do seu PC
        if (ehOAluno) {
            Serial.printf("ACESSO LIBERADO Amanda! (SAD: %ld)\n", diferenca);
        } else {
            Serial.printf("ACESSO NEGADO - Rosto estranho (SAD: %ld)\n", diferenca);
        }
    }
}
// =========================================================================
void setup() {
    Serial.begin(115200);
    Serial.setTimeout(500); 

    // Inicialização do Wi-Fi em modo Station (necessário para ESP-NOW)
    WiFi.mode(WIFI_STA);

    // Inicializa o protocolo ESP-NOW
    if (esp_now_init() != ESP_OK) {
        Serial.println("Erro ao inicializar ESP-NOW");
        return;
    }

    // Registra a segunda ESP32 (Peer) para podermos enviar dados para ela
    memcpy(peerInfo.peer_addr, macESP2, 6);
    peerInfo.channel = 0;  
    peerInfo.encrypt = false;
    
    if (esp_now_add_peer(&peerInfo) != ESP_OK){
        Serial.println("Falha ao adicionar peer");
        return;
    }

    xTaskCreatePinnedToCore(receiveSerialTask, "RxTask", 4096, NULL, 1, NULL, 0);
    xTaskCreatePinnedToCore(processImageTask, "ProcTask", 8192, NULL, 2, &TaskProcess_Handle, 1);
}

void loop() {
    vTaskDelete(NULL); 
}